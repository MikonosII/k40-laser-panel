## main/Kconfig.projbuild
```kconfig
menu "K40 panel"

    menu "Wi-Fi / LightBurn"
        config K40_WIFI_SSID
            string "Wi-Fi SSID"
            default ""
        config K40_WIFI_PASSWORD
            string "Wi-Fi password"
            default ""
        config K40_HOSTNAME
            string "Network hostname"
            default "k40-panel"
        config K40_TIMEZONE
            string "Time zone (POSIX TZ) for job history times"
            default "CST6CDT,M3.2.0,M11.1.0"
            help
                The panel sets its clock from the internet (pool.ntp.org) once Wi-Fi is up.
                US Central is the default; Eastern is EST5EDT,M3.2.0,M11.1.0,
                Pacific is PST8PDT,M3.2.0,M11.1.0.
        config K40_TELNET_PORT
            int "LightBurn TCP port"
            default 23
        config K40_ALLOWED_IP
            string "Only accept LightBurn from this IP (blank = any)"
            default ""
            help
                Set this to your LightBurn PC's reserved IP, e.g. 192.168.1.50.
                Anything else on the network is refused.
    endmenu

    menu "grblHAL link"
        config K40_GRBL_BAUD
            int "UART baud to the SKR"
            default 115200
        config K40_GRBL_TX_GPIO
            int "Panel TX GPIO (UART3-IN TX -> SKR PA3/RX)"
            default 27
        config K40_GRBL_RX_GPIO
            int "Panel RX GPIO (UART3-IN RX <- SKR PA2/TX)"
            default 28
            help
                UART3-IN (J10) is the 4-pin XH2.54 header under the USB-C ports:
                1 TX, 2 RX, 3 +5V_IN, 4 GND. Its TX/RX are level-shifted to the
                5V on pin 3, so that pin must be powered (from a 5V supply,
                not the SKR) for the link to work.
    endmenu

    menu "Laser"
        config K40_S_MAX
            int "Spindle max ($30)"
            default 1000
        config K40_MAX_POWER_PCT
            int "Panel test/pointer power cap (%)"
            range 1 100
            default 70
            help
                Highest power the panel itself will ever command.
                Set it to the duty that gives your tube's safe current.
        config K40_POINTER_PCT
            int "Pointer power (%)"
            range 0 10
            default 1
        config K40_MA_SHUNT_MOHM
            int "Tube current sensor shunt (milliohms)"
            default 100
            help
                Shunt resistor on the INA226/INA219 breakout. The common
                CJMCU-226 and INA219 boards use 0.1 ohm (R100) = 100.
        config K40_MA_LIMIT
            int "Default tube current warning limit (mA)"
            range 5 40
            default 18
        config K40_MA_TRIP
            int "Default tube current shut-off limit (mA)"
            range 5 40
            default 20
            help
                Above this for ~60 ms the panel soft-resets grblHAL (laser off,
                motion stops) and latches a fault until cleared on the panel.
        config K40_EXHAUST_AUX_PORT
            int "Exhaust aux output (M64/M65 P#), -1 = hide button"
            range -1 7
            default -1
    endmenu

    menu "Display"
        choice K40_ROTATION
            prompt "Portrait orientation"
            default K40_ROTATION_90
            config K40_ROTATION_90
                bool "Rotate 90 degrees"
            config K40_ROTATION_270
                bool "Rotate 270 degrees (flip if upside down)"
        endchoice
        config K40_PCLK_HZ
            int "RGB pixel clock (Hz)"
            default 18000000
            help
                Elecrow's example code uses 18 MHz.
        config K40_BACKLIGHT_PCT
            int "Backlight brightness (%)"
            range 0 100
            default 100
        config K40_SWAP_COLOR_BYTES
            bool "Swap RGB565 bytes (enable if colors look scrambled)"
            default n
    endmenu

endmenu
```

## sdkconfig.defaults
```kconfig
# --- Target: CrowPanel Advanced 5" ESP32-P4 (DHE04005D) ---
CONFIG_IDF_TARGET="esp32p4"
# Elecrow ships P4 silicon rev v1.x (their firmware is built with REV_MIN_1)
CONFIG_ESP32P4_SELECTS_REV_LESS_V3=y
CONFIG_ESP32P4_REV_MIN_1=y
CONFIG_ESPTOOLPY_FLASHSIZE_16MB=y
CONFIG_PARTITION_TABLE_CUSTOM=y
CONFIG_PARTITION_TABLE_CUSTOM_FILENAME="partitions.csv"
CONFIG_SPIRAM=y
CONFIG_SPIRAM_MODE_HEX=y
CONFIG_SPIRAM_SPEED_200M=y
CONFIG_SPIRAM_USE_MALLOC=y

# --- Performance ---
CONFIG_ESP_DEFAULT_CPU_FREQ_MHZ_360=y
CONFIG_COMPILER_OPTIMIZATION_PERF=y
CONFIG_FREERTOS_HZ=1000

# --- RGB LCD ---
CONFIG_LCD_RGB_ISR_IRAM_SAFE=y

# --- Wi-Fi via the on-board ESP32-C6 (esp_hosted over SDIO), pins from Elecrow ---
CONFIG_ESP_HOSTED_ENABLED=y
CONFIG_ESP_HOSTED_CP_TARGET_ESP32C6=y
CONFIG_ESP_HOSTED_P4_DEV_BOARD_NONE=y
CONFIG_ESP_HOSTED_SDIO_HOST_INTERFACE=y
CONFIG_ESP_HOSTED_SDIO_SLOT_1=y
CONFIG_ESP_HOSTED_SDIO_4_BIT_BUS=y
CONFIG_ESP_HOSTED_SDIO_CLOCK_FREQ_KHZ=40000
CONFIG_ESP_HOSTED_SDIO_RESET_ACTIVE_HIGH=y
CONFIG_ESP_HOSTED_SDIO_GPIO_RESET_SLAVE=20
CONFIG_ESP_HOSTED_SDIO_PIN_CMD=54
CONFIG_ESP_HOSTED_SDIO_PIN_CLK=53
CONFIG_ESP_HOSTED_SDIO_PIN_D0=52
CONFIG_ESP_HOSTED_SDIO_PIN_D1_4BIT_BUS=51
CONFIG_ESP_HOSTED_SDIO_PIN_D2_4BIT_BUS=50
CONFIG_ESP_HOSTED_SDIO_PIN_D3_4BIT_BUS=49
CONFIG_ESP_HOSTED_PRIV_SDIO_PIN_CMD_SLOT_1=54
CONFIG_ESP_HOSTED_PRIV_SDIO_PIN_CLK_SLOT_1=53
CONFIG_ESP_HOSTED_PRIV_SDIO_PIN_D0_SLOT_1=52
CONFIG_ESP_HOSTED_PRIV_SDIO_PIN_D1_4BIT_BUS_SLOT_1=51
CONFIG_ESP_HOSTED_PRIV_SDIO_PIN_D2_4BIT_BUS_SLOT_1=50
CONFIG_ESP_HOSTED_PRIV_SDIO_PIN_D3_4BIT_BUS_SLOT_1=49
CONFIG_ESP_WIFI_REMOTE_LIBRARY_HOSTED=y
CONFIG_LWIP_TCP_NODELAY=y

# --- LVGL 9 ---
CONFIG_LV_COLOR_DEPTH_16=y
CONFIG_LV_USE_CLIB_MALLOC=y
CONFIG_LV_USE_CLIB_STRING=y
CONFIG_LV_USE_CLIB_SPRINTF=y
CONFIG_LV_DEF_REFR_PERIOD=20
CONFIG_LV_FONT_MONTSERRAT_14=y
CONFIG_LV_FONT_MONTSERRAT_16=y
CONFIG_LV_FONT_MONTSERRAT_20=y
CONFIG_LV_FONT_MONTSERRAT_24=y
CONFIG_LV_FONT_MONTSERRAT_28=y
CONFIG_LV_FONT_MONTSERRAT_40=y
CONFIG_LV_FONT_DEFAULT_MONTSERRAT_16=y
CONFIG_LV_USE_LOG=n
CONFIG_LV_USE_OBSERVER=n
CONFIG_LV_BUILD_EXAMPLES=n
CONFIG_LV_BUILD_DEMOS=n
```
